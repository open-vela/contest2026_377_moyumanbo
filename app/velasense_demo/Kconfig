## firmware/drivers/max30208/Kconfig
```kconfig
#
# MAX30208 Digital Temperature Sensor Kconfig
#

config SENSORS_MAX30208
	bool "MAX30208 skin temperature sensor"
	default y if VELASENSE
	depends on I2C
	---help---
		Enable the MAX30208 precision digital temperature sensor driver.
		The MAX30208 is a high-accuracy (±0.1°C) I2C temperature sensor
		designed for wearable skin temperature measurement.

if SENSORS_MAX30208

config MAX30208_I2C_BUS
	int "I2C bus number"
	default 1
	---help---
		I2C bus number for the MAX30208 sensor (e.g., 1 for /dev/i2c1).

config MAX30208_I2C_ADDR
	hex "I2C address (7-bit)"
	default 0x50
	---help---
		I2C slave address of the MAX30208. Default is 0x50.

config MAX30208_POLL_RATE
	int "Polling rate (Hz)"
	default 1
	range 1 10
	---help---
		Temperature reading rate in Hz. Default is 1 Hz.

config MAX30208_ALARM_ENABLE
	bool "Enable temperature alarms"
	default n
	---help---
		Enable high/low temperature alarm thresholds.

config MAX30208_ALARM_HIGH
	int "High alarm threshold (°C x10)"
	default 380
	---help---
		High temperature alarm threshold in 0.1°C units.
		Default 380 = 38.0°C.

config MAX30208_ALARM_LOW
	int "Low alarm threshold (°C x10)"
	default 320
	---help---
		Low temperature alarm threshold in 0.1°C units.
		Default 320 = 32.0°C.

endif # SENSORS_MAX30208
```

## firmware/drivers/max86141/Kconfig
```kconfig
# MAX86141 PPG sensor driver configuration
#
# SPDX-License-Identifier: Apache-2.0
#
# Copyright (C) 2026 VelaSense Project

config MAX86141
	bool "MAX86141 PPG sensor driver"
	default n
	depends on SPI
	depends on GPIO
	---help---
	  Enable the MAX86141 three-wavelength PPG sensor driver.
	  The MAX86141 is a Maxim/Analog Devices optical pulse oximetry
	  and heart-rate sensor AFE with SPI interface.

	  The driver publishes PPG data to the uORB "sensor_ppgd" topic
	  at the configured sample rate.

if MAX86141

config MAX86141_SPI_BUS
	int "SPI bus number"
	default 1
	---help---
	  SPI bus number to which the MAX86141 is connected.
	  The MAX86141 uses 4-wire SPI at up to 10 MHz.

config MAX86141_SPI_CS
	int "SPI chip-select index"
	default 0
	---help---
	  Chip-select index for the MAX86141 on the SPI bus.

config MAX86141_SPI_FREQ
	int "SPI clock frequency (Hz)"
	default 8000000
	range 1000000 10000000
	---help---
	  SPI clock frequency in Hz.  The MAX86141 supports up to 10 MHz.
	  Default is 8 MHz for reliable operation.

config MAX86141_IRQ_PIN
	int "GPIO pin for FIFO watermark interrupt"
	default 23
	---help---
	  GPIO pin number connected to the MAX86141 INT output.
	  The interrupt fires when the FIFO watermark is reached.
	  The pin should be configured as input with pull-up.

config MAX86141_IRQ_ACTIVE_LOW
	bool "Interrupt is active-low"
	default y
	---help---
	  The MAX86141 INT output is active-low (open-drain).
	  Select this if the interrupt line is active-low.

config MAX86141_SAMPLE_RATE
	int "PPG sample rate (Hz)"
	default 100
	range 1 1000
	---help---
	  PPG sample rate in Hz.  For wrist-based heart-rate monitoring,
	  100 Hz is a good default.  For pulse oximetry (SpO2), 200 Hz
	  or higher is recommended.

	  Valid values: 1, 10, 25, 50, 100, 200, 300, 400, 500, 600,
	  800, 1000.

config MAX86141_FIFO_WATERMARK
	int "FIFO watermark level (samples)"
	default 15
	range 1 31
	---help---
	  FIFO watermark (interrupt threshold) in samples.
	  The interrupt fires when this many samples are available.
	  Setting to half the FIFO depth (15-16) provides a good
	  balance between latency and efficiency.

config MAX86141_FIFO_ROLLOVER
	bool "Enable FIFO rollover on overflow"
	default n
	---help---
	  When enabled, new samples overwrite old ones when the FIFO
	  is full.  When disabled (default), new samples are dropped
	  when the FIFO is full.

config MAX86141_PULSE_WIDTH
	int "LED pulse width (0=50us, 1=100us, 2=200us, 3=400us)"
	default 2
	range 0 3
	---help---
	  LED pulse width / ADC integration time.
	  Longer pulse width gives more ADC resolution but slower
	  maximum sample rate.
	    0: 50 us  (15-bit effective)
	    1: 100 us (16-bit effective)
	    2: 200 us (17-bit effective) [default]
	    3: 400 us (18-bit effective)

config MAX86141_SAMPLE_AVERAGE
	int "Sample averaging factor (0=none, 1=2x, 2=4x, 3=8x, 4=16x, 5=32x)"
	default 2
	range 0 5
	---help---
	  Number of ADC samples averaged before pushing to FIFO.
	  More averaging reduces noise but increases effective sample
	  period.
	    0: No averaging
	    1: 2 samples
	    2: 4 samples [default]
	    3: 8 samples
	    4: 16 samples
	    5: 32 samples

config MAX86141_ADC_RANGE
	int "ADC range (0=4096, 1=8192, 2=16384, 3=32768)"
	default 2
	range 0 3
	---help---
	  ADC measurement range in nA.
	    0: +/- 4096 nA  (best for low-perfusion)
	    1: +/- 8192 nA
	    2: +/- 16384 nA [default]
	    3: +/- 32768 nA (max dynamic range)

config MAX86141_LED_GREEN_MA
	int "Green LED current (mA)"
	default 20
	range 0 204
	---help---
	  Initial green LED current in milliamps.
	  Green is the primary wavelength for wrist PPG.
	  Typical range: 10 - 40 mA.

config MAX86141_LED_RED_MA
	int "Red LED current (mA)"
	default 15
	range 0 204
	---help---
	  Initial red LED current in milliamps.
	  Red is used for SpO2 measurement.
	  Typical range: 10 - 40 mA.

config MAX86141_LED_IR_MA
	int "IR LED current (mA)"
	default 15
	range 0 204
	---help---
	  Initial IR LED current in milliamps.
	  IR is used for SpO2 measurement.
	  Typical range: 10 - 40 mA.

config MAX86141_UORB
	bool "Enable uORB integration"
	default y
	depends on MAX86141
	---help---
	  Enable automatic uORB publication of sensor_ppgd data.
	  When enabled, the driver creates a worker thread that:
	    1. Blocks on the FIFO watermark GPIO interrupt
	    2. Reads the FIFO
	    3. Computes SQI
	    4. Publishes to uORB sensor_ppgd topic at the configured
	       sample rate

config MAX86141_UORB_START
	bool "Auto-start uORB worker on boot"
	default y
	depends on MAX86141_UORB
	---help---
	  Automatically start the MAX86141 uORB worker thread at boot.
	  If disabled, the driver must be started manually via
	  max86141_uorb_start().

endif # MAX86141
```

## firmware/libs/inference/Kconfig
```kconfig
# ===========================================================================
# Kconfig -- VelaSense TinyML Inference Engine
#
# Menu path: VelaScene -> Inference
#
# These options control the inference engine behaviour, debug output, and
# the rule-based gating thresholds that protect the ML pipeline from
# unreliable sensor data.
# ===========================================================================

menu "Inference Engine"

config VELASENSE_INFERENCE
    bool "Enable TinyML inference engine"
    default y
    help
        Build the INT8 quantised inference engine for emotion arousal
        detection.  Disable to strip all ML code from the firmware
        (useful for sensor-only debugging builds).

config VELASENSE_RULE_GATE
    bool "Enable rule-based gating before inference"
    default y
    depends on VELASENSE_INFERENCE
    help
        Run the rule gate before each inference pass.  If any sensor
        health check fails the inference is skipped and a reason code
        is returned to the caller.  Disabling this sends all samples
        directly to the ML model.

config TINYML_DEBUG
    bool "Debug output for inference engine"
    default n
    depends on VELASENSE_INFERENCE
    help
        Enable verbose logging of quantisation parameters, layer
        shapes, and per-layer timing.  Increases code size by ~800
        bytes.  Do NOT enable in production builds.

config TINYML_TIMING
    bool "Report inference timing"
    default y
    depends on VELASENSE_INFERENCE
    help
        Measure wall-clock microseconds for each inference pass and
        store the result in tinyml_result_t.inference_us.  Requires a
        working microsecond timer (DWT->CYCCNT on Cortex-M).

# ---------------------------------------------------------------------------
# Rule gate thresholds
# ---------------------------------------------------------------------------

config RULE_SQI_MIN
    float "Minimum PPG signal quality index (SQI)"
    default 0.70
    range 0.1 1.0
    depends on VELASENSE_RULE_GATE
    help
        PPG signals with SQI below this threshold are rejected.
        Valid range: 0.10 to 1.00.  Typical: 0.70.

config RULE_TEMP_SLOPE_MAX
    float "Max temperature slope (deg-C per minute)"
    default 2.0
    range 0.5 10.0
    depends on VELASENSE_RULE_GATE
    help
        Reject samples when the skin temperature is changing faster
        than this rate, as it indicates an environmental artefact
        rather than a physiological response.  Typical: 2.0 C/min.

config RULE_ACTIVITY_MAX
    int "Maximum activity level to proceed (0-3)"
    default 2
    range 0 3
    depends on VELASENSE_RULE_GATE
    help
        Activity intensity levels:
          0 = rest / seated
          1 = light (slow walk)
          2 = moderate (brisk walk)
          3 = vigorous (running / cycling)
        Inference is skipped for activity above this level.
        Typical: 2 (moderate).

config RULE_BATTERY_MIN
    int "Minimum battery percentage for inference"
    default 5
    range 0 50
    depends on VELASENSE_RULE_GATE
    help
        When battery drops below this level the inference engine is
        disabled to conserve power.  Set to 0 to disable this check.

endmenu
```
