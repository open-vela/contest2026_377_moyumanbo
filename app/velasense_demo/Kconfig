## firmware/boards/velasense_board/configs/nsh/defconfig
```kconfig
#
# VelaSense Board Configuration
# Based on SF32LB52-DevKit-LCD
# Target: 腕式情绪唤醒识别终端
#

# --- Architecture ---
CONFIG_ARCH="arm"
CONFIG_ARCH_ARM=y
CONFIG_ARCH_ARMV8M=y
CONFIG_ARCH_CORTEXM33=y
CONFIG_ARCH_CHIP_SF32LB52=y
CONFIG_ARCH_CHIP_CUSTOM_DIR="../vendor/sifli/chips/sf32lb52"
CONFIG_ARCH_FPU=y
CONFIG_ARCH_DSP=y
CONFIG_ARM_MPU=y
CONFIG_ARCH_BOARD="velasense_board"
CONFIG_ARCH_BOARD_CUSTOM_DIR="../contest2026_377_moyumanbo/firmware/boards/velasense_board"
CONFIG_BOARD_LOOPSPERMSEC=8499

# --- System ---
CONFIG_BOARD_LATE_INITIALIZE=y
CONFIG_BOARDCTL=y
CONFIG_NSH_LIBRARY=y
CONFIG_SYSTEM_NSH=y
CONFIG_INIT_ENTRYPOINT="nsh_main"

# --- Memory ---
CONFIG_MM_HEAP_MEMPOOLSIZE=8388608
CONFIG_MM_DEFAULT_ALIGNMENT=8

# --- Console / UART ---
CONFIG_UART1_SERIAL_CONSOLE=y
CONFIG_UART1_BAUD=1000000
CONFIG_UART1_BITS=8
CONFIG_UART1_PARITY=0
CONFIG_UART1_2STOP=0
CONFIG_SERIAL_TERMIOS=y

# --- Debug UART ---
CONFIG_UART2_SERIAL=y
CONFIG_UART2_BAUD=1000000

# --- LCD / Display ---
CONFIG_SIFLI_LCD=y
CONFIG_LCD_USING_CO5300=y
CONFIG_LCD=y
CONFIG_LCD_DEV=y
CONFIG_LCD_FRAMEBUFFER=y
CONFIG_LCD_MAXPOWER=100
CONFIG_BSP_USING_LCDC=y
CONFIG_VIDEO_FB=y

# --- Touch ---
CONFIG_BSP_USING_TOUCHD=y
CONFIG_INPUT_FT6146=y
CONFIG_INPUT_TOUCHSCREEN=y

# --- LVGL ---
CONFIG_GRAPHICS_LVGL=y
CONFIG_LV_USE_NUTTX=y
CONFIG_LV_USE_NUTTX_LCD=y
CONFIG_LV_USE_NUTTX_TOUCHSCREEN=y
CONFIG_LV_FONT_MONTSERRAT_14=y
CONFIG_LV_FONT_MONTSERRAT_20=y
CONFIG_LV_THEME_DEFAULT_DARK=y

# --- Backlight PWM ---
CONFIG_PWM=y
CONFIG_BSP_USING_PWM=y
CONFIG_SIFLI_PWM=y

# --- GPIO ---
CONFIG_DEV_GPIO=y
CONFIG_BSP_USING_GPIO=y

# --- I2C ---
CONFIG_I2C=y
CONFIG_BSP_USING_I2C1=y

# --- SPI ---
CONFIG_SPI=y
CONFIG_BSP_USING_SPI1=y

# --- ADC ---
CONFIG_ADC=y
CONFIG_BSP_USING_ADC=y
CONFIG_SIFLI_ADC=y

# --- RTC ---
CONFIG_RTC=y
CONFIG_BSP_USING_RTC=y
CONFIG_SIFLI_RTC=y

# --- Watchdog ---
CONFIG_WATCHDOG=y
CONFIG_BSP_USING_WDT=y
CONFIG_SIFLI_IWDG=y

# --- Timer ---
CONFIG_TIMER=y
CONFIG_BSP_USING_TIM=y

# --- Buttons ---
CONFIG_INPUT_BUTTONS=y
CONFIG_INPUT_BUTTONS_NBUTTONS=2

# --- Flash / MTD ---
CONFIG_MTD=y
CONFIG_SIFLI_FLASH=y
CONFIG_BSP_USING_MPI2=y
CONFIG_FS_LITTLEFS=y
CONFIG_FS_ROMFS=y
CONFIG_FS_PROCFS=y
CONFIG_FS_TMPFS=y

# --- Bluetooth ---
CONFIG_BT=y
CONFIG_BT_CLASSIC=y
CONFIG_BT_BLE=y
CONFIG_BT_GATT_CLIENT=y
CONFIG_BT_GATT_DYNAMIC_DB=y
CONFIG_BT_H4=y
CONFIG_BT_POWER_MODE_CONTROL=y
CONFIG_BT_PRIVACY=y
CONFIG_DRIVERS_BLUETOOTH=y
CONFIG_DRIVERS_WIRELESS=y

# --- USB ---
CONFIG_USBDEV=y
CONFIG_CDCACM=y
CONFIG_SF32LB52_USBDEV=y

# --- uORB Sensor Framework ---
CONFIG_UORB=y

# --- VelaSense Application ---
CONFIG_VELASENSE=y

# --- Power Management ---
CONFIG_PM=y

# --- Filesystems ---
CONFIG_FS=y
```

## firmware/drivers/ad5940/Kconfig
```kconfig
#
# AD5940 Electrodermal Activity (EDA) Analog Frontend Kconfig
#

config SENSORS_AD5940
	bool "AD5940 EDA/impedance analog frontend"
	default y if VELASENSE
	depends on SPI
	---help---
		Enable the AD5940 electrodermal activity (EDA) analog frontend
		driver. The AD5940 is a high-precision bioimpedance measurement
		frontend from Analog Devices, configured here for galvanic skin
		response (GSR/EDA) measurement.

		Features:
		  - 16-bit ADC with programmable gain
		  - DC excitation for skin conductance measurement
		  - Hardware low-pass filter for motion artifact rejection
		  - Skin conductance response (SCR) event detection
		  - Low-power hibernate mode (<5 uA)

if SENSORS_AD5940

config AD5940_SPI_BUS
	int "SPI bus number"
	default 2
	---help---
		SPI bus number for the AD5940 (e.g., 2 for /dev/spi2).

config AD5940_SPI_FREQ
	int "SPI clock frequency (Hz)"
	default 16000000
	range 1000000 16000000
	---help---
		SPI clock frequency in Hz. Maximum is 16 MHz.
		Higher frequencies improve data throughput but may cause
		signal integrity issues on long PCB traces.

config AD5940_CS_PIN
	int "Chip select GPIO pin (-1 for HW CS)"
	default -1
	---help---
		GPIO pin number for SPI chip select. Use -1 to use the
		hardware chip select provided by the SPI controller.

config AD5940_IRQ_PIN
	int "Data-ready interrupt GPIO pin (-1 for polling)"
	default -1
	---help---
		GPIO pin for the AD5940 interrupt output. Use -1 for
		polling mode (reads triggered by timer). Interrupt mode
		reduces CPU usage and improves timing accuracy.

config AD5940_RESET_PIN
	int "Hardware reset GPIO pin (-1 for SW reset only)"
	default -1
	---help---
		GPIO pin for the AD5940 hardware reset line. Use -1 to
		rely on software reset only. Hardware reset is more
		reliable for initial power-on sequencing.

config AD5940_SAMPLE_RATE
	int "EDA sample rate (Hz)"
	default 32
	range 1 200
	---help---
		Skin conductance sampling rate in Hz. Default 32 Hz provides
		good temporal resolution for SCR event detection while keeping
		data rate manageable. Range: 1-200 Hz.

config AD5940_EDA_EXCIT_MV
	int "DC excitation voltage (mV)"
	default 100
	range 10 500
	---help---
		DC excitation voltage applied across skin electrodes in
		millivolts. Default 100 mV balances signal quality (SNR)
		against electrode polarization. Higher values may cause
		skin irritation; lower values reduce SNR.

config AD5940_TIA_GAIN
	int "TIA gain setting (see datasheet)"
	default 10
	range 0 25
	---help---
		Transimpedance amplifier gain register value. See the
		AD5940 datasheet Table 25 for the mapping between register
		value and gain in ohms:
		  0=200, 1=1k, 2=2k, 3=3k, 4=4k, 5=6k, 6=8k, 7=10k,
		  8=12k, 9=16k, 10=20k, 11=24k, 12=30k, 13=32k, 14=40k,
		  15=48k, 16=64k, 17=85k, 18=96k, 19=100k, 20=120k,
		  21=128k, 22=160k, 23=196k, 24=256k, 25=512k

		Default 10 = 20 kohm, suitable for typical GSR range.

config AD5940_FILTER_CUTOFF
	int "Low-pass filter cutoff frequency (Hz x10)"
	default 150
	range 10 2000
	---help---
		Analog/digital low-pass filter cutoff frequency in 0.1 Hz
		units. Default 150 = 15.0 Hz. This filter removes motion
		artifacts while preserving SCR signals (typical bandwidth
		0.05 - 5 Hz).

config AD5940_SCR_THRESHOLD
	int "SCR detection threshold (uS x1000)"
	default 50
	range 10 500
	---help---
		Minimum skin conductance increase (in 0.001 uS units) to
		trigger an SCR event. Default 50 = 0.050 uS. Lower values
		detect more events but increase false positives. Higher
		values may miss subtle responses.

config AD5940_SCR_ALPHA
	int "Baseline EMA alpha (x1000)"
	default 10
	range 1 100
	---help---
		Exponential moving average alpha for baseline tracking
		(x1000). Default 10 = 0.010. Lower values give slower
		baseline adaptation (more stable). Higher values adapt
		faster to tonic changes.

config AD5940_UORB_ENABLE
	bool "Enable uORB publishing"
	default y
	---help---
		Publish EDA data to the uORB sensor_impd topic at the
		configured sample rate. Disable to use the driver in
		polling mode only (manual ad5940_read_eda calls).

config AD5940_UORB_STACK_SIZE
	int "uORB task stack size (bytes)"
	default 4096
	---help---
		Stack size for the background EDA measurement task.
		Default 4096 bytes is sufficient for the driver logic
		and syslog calls.

config AD5940_LOG_LEVEL
	int "Driver log level (0=off, 7=max)"
	default 5
	range 0 7
	---help---
		Syslog verbosity level for the AD5940 driver:
		  0 = no logging
		  3 = errors only (LOG_ERR)
		  5 = info level (LOG_INFO) -- default
		  7 = debug (LOG_DEBUG) -- very verbose

endif # SENSORS_AD5940
```

## firmware/drivers/icm42688/Kconfig
```kconfig
#
# ICM-42688-P Six-Axis IMU Kconfig
#

config SENSORS_ICM42688
	bool "ICM-42688-P 6-axis IMU (accel + gyro)"
	default y if VELASENSE
	depends on SPI
	---help---
		Enable the ICM-42688-P six-axis inertial measurement unit driver.
		The ICM-42688-P is a TDK InvenSense 3-axis accelerometer + 3-axis
		gyroscope with SPI interface, 2KB FIFO, and data-ready interrupt.
		Used for motion sensing and PPG motion artifact removal.

if SENSORS_ICM42688

config ICM42688_SPI_BUS
	int "SPI bus number"
	default 1
	---help---
		SPI bus number for the ICM-42688-P (e.g., 1 for /dev/spi1).
		On the VelaSense board, the IMU shares SPI1 with the PPG
		and EDA sensors, each with a separate chip-select.

config ICM42688_CS_INDEX
	int "Chip-select index"
	default 1
	---help---
		Chip-select index on the SPI bus for the ICM-42688-P.
		0 = CS0 (PPG/MAX86141), 1 = CS1 (IMU), 2 = CS2 (EDA/AD5940).

config ICM42688_IRQ_PIN
	int "Interrupt GPIO pin"
	default -1
	---help---
		GPIO pin number for the ICM-42688-P INT1 data-ready interrupt.
		Set to -1 for polling mode (no hardware interrupt).
		On the VelaSense board, connect INT1 to a free GPIO.

config ICM42688_ACCEL_FSR
	int "Accelerometer full-scale range"
	default 1
	range 0 3
	---help---
		Accelerometer full-scale range:
		  0 = +/-16g
		  1 = +/-8g  (VelaSense default)
		  2 = +/-4g
		  3 = +/-2g

config ICM42688_GYRO_FSR
	int "Gyroscope full-scale range"
	default 0
	range 0 7
	---help---
		Gyroscope full-scale range:
		  0 = +/-2000 dps (VelaSense default)
		  1 = +/-1000 dps
		  2 = +/-500 dps
		  3 = +/-250 dps
		  4 = +/-125 dps
		  5 = +/-62.5 dps
		  6 = +/-31.25 dps
		  7 = +/-15.625 dps

config ICM42688_ACCEL_ODR
	int "Accelerometer output data rate (Hz)"
	default 100
	range 12 32000
	---help---
		Accelerometer output data rate in Hz.
		Supported rates: 12, 25, 50, 100, 200, 500, 1000, 2000,
		4000, 8000, 16000, 32000.
		Default is 100 Hz for VelaSense.

config ICM42688_GYRO_ODR
	int "Gyroscope output data rate (Hz)"
	default 100
	range 12 32000
	---help---
		Gyroscope output data rate in Hz.
		Supported rates: 12, 25, 50, 100, 200, 500, 1000, 2000,
		4000, 8000, 16000, 32000.
		Default is 100 Hz for VelaSense.

config ICM42688_USE_FIFO
	bool "Use hardware FIFO"
	default y
	---help---
		Enable the ICM-42688-P hardware FIFO for batch reading.
		The FIFO accumulates samples and triggers a watermark
		interrupt, reducing SPI bus overhead. Recommended for
		100 Hz operation. Disable only for debugging.

config ICM42688_FIFO_WATERMARK
	int "FIFO watermark level (packets)"
	default 16
	range 1 128
	depends on ICM42688_USE_FIFO
	---help---
		FIFO watermark level in packets. When the FIFO contains
		this many packets, the watermark interrupt fires.
		Each packet is 16 bytes (accel + gyro + timestamp).
		At 100 Hz ODR, watermark=16 means 160ms between reads.
		Lower values reduce latency, higher values reduce SPI overhead.

config ICM42688_FIFO_MODE
	int "FIFO mode"
	default 1
	range 0 2
	depends on ICM42688_USE_FIFO
	---help---
		FIFO operating mode:
		  0 = Bypass (disabled)
		  1 = Stream mode (old data overwritten when full)
		  2 = Stop-on-full (recording stops when FIFO is full)

endif # SENSORS_ICM42688
```

## firmware/drivers/max17048/Kconfig
```kconfig
# MAX17048 Battery Fuel Gauge Driver Configuration
#
# Copyright (c) 2026 VelaSense Project
# SPDX-License-Identifier: MIT

menuconfig MAX17048
	bool "MAX17048 battery fuel gauge"
	default y
	help
	  Enable the Maxim / Analog Devices MAX17048 Li-ion battery fuel
	  gauge driver.  The MAX17048 communicates over I2C and provides
	  voltage-based state-of-charge estimation without a sense resistor.

	  Supported features:
	    - Battery voltage measurement (12-bit ADC)
	    - State of charge estimation (1/256 % resolution)
	    - Charge / discharge rate monitoring
	    - Programmable low-battery alert with callback
	    - Quick-start SOC recalibration
	    - Hibernate and sleep power-saving modes

if MAX17048

config MAX17048_I2C_BUS
	string "I2C bus device name"
	default "I2C0"
	help
	  Name of the I2C bus device the MAX17048 is connected to
	  (e.g. "I2C0", "i2c-1").

config MAX17048_I2C_ADDRESS
	hex "I2C slave address (7-bit)"
	default 0x36
	help
	  7-bit I2C slave address of the MAX17048.  The factory default
	  is 0x36.  Change this only if the address pin is externally
	  modified (the MAX17048 has a fixed address -- this option exists
	  for board-level verification).

config MAX17048_ALERT_THRESHOLD
	int "Low battery alert threshold (percent)"
	default 20
	range 0 31
	help
	  SOC percentage at which the MAX17048 asserts the ALERT output.
	  VelaSense default is 20 % (single Li-ion cell).
	  Set to 0 to disable the SOC-low alert.

config MAX17048_CRIT_THRESHOLD
	int "Critical battery threshold (percent)"
	default 5
	range 0 100
	help
	  SOC percentage at which the application should initiate a
	  controlled shutdown.  VelaSense default is 5 %.

config MAX17048_VOLTAGE_LOW_MV
	int "Low voltage alert threshold (mV)"
	default 3300
	range 0 5100
	help
	  Lower voltage alert threshold in millivolts.  The MAX17048
	  asserts an alert when VCELL drops below this value.
	  VelaSense default: 3300 mV (approx. 20 % SOC for Li-ion).

config MAX17048_VOLTAGE_HIGH_MV
	int "High voltage alert threshold (mV)"
	default 0
	range 0 5100
	help
	  Upper voltage alert threshold in millivolts.  Set to 0 to
	  disable the upper voltage alert.  VelaSense default: 0
	  (disabled -- charging circuitry handles overvoltage).

config MAX17048_RESET_VOLTAGE_MV
	int "Reset voltage threshold (mV)"
	default 3100
	range 0 5080
	help
	  Voltage threshold for the fuel gauge reset comparator.
	  Below this voltage the MAX17048 asserts a voltage-reset alert.
	  VelaSense default: 3100 mV (approx. 5 % SOC).
	  Values are quantised to 40 mV steps.

config MAX17048_READ_INTERVAL_S
	int "Battery read interval (seconds)"
	default 60
	range 5 3600
	help
	  How often the application reads battery telemetry (SOC, voltage,
	  rate).  VelaSense default: 60 seconds.
	  Lower values increase bus traffic; higher values reduce
	  resolution of charge-rate estimation.

config MAX17048_DEFAULT_RCOMP
	hex "Default RCOMP compensation value"
	default 0x97
	range 0x00 0xFF
	help
	  Default value for the RCOMP field in the CONFIG register.
	  RCOMP adjusts the fuel gauge model for temperature.
	  The datasheet default is 0x97 at 20 degC.

config MAX17048_ENABLE_HIBERNATE
	bool "Enable hibernate mode support"
	default y
	help
	  Compile in hibernate mode entry / exit functions.  Hibernate
	  mode reduces the fuel gauge's power consumption to ~2 uA
	  when the battery is idle.

config MAX17048_HIBRT_THRESHOLD
	int "Hibernate activity threshold (0-255)"
	default 0
	range 0 255
	depends on MAX17048_ENABLE_HIBERNATE
	help
	  Activity threshold for hibernate entry.  The fuel gauge
	  enters hibernate when the absolute CRATE value stays below
	  this threshold.  0 = use device default.

config MAX17048_ACTRT_THRESHOLD
	int "Activity exit threshold (0-255)"
	default 0
	range 0 255
	depends on MAX17048_ENABLE_HIBERNATE
	help
	  Activity threshold for hibernate exit.  The fuel gauge
	  exits hibernate when the absolute CRATE value exceeds
	  this threshold.  0 = use device default.

config MAX17048_ENABLE_QUICKSTART
	bool "Enable quick-start recalibration"
	default y
	help
	  Compile in the quick-start function, which triggers an
	  open-circuit voltage measurement and recalculates SOC.
	  Useful after battery replacement or known SOC drift.

endif # MAX17048
```
