## app/velasense_demo/Kconfig
```kconfig
config VELASENSE_UI_DEMO
  bool "VelaSense display demo"
  default n
  depends on GRAPHICS_LVGL
  depends on LV_USE_NUTTX_LCD
  select LV_FONT_MONTSERRAT_18
  select LV_FONT_MONTSERRAT_24
  select LV_FONT_MONTSERRAT_48
  ---help---
    Display-only VelaSense application with sample data. No sensors,
    Bluetooth, model, or storage required. Builtin command: velasense.
```

## board/velasense/configs/ui_demo/defconfig
```kconfig
#
# VelaSense Board Configuration
# Based on SF32LB52-DevKit-LCD
# Target: 腕式情绪唤醒识别终端
#

# --- Architecture ---
CONFIG_ARCH="arm"
CONFIG_ARCH_BOARD_CUSTOM=y
CONFIG_ARCH_BOARD_CUSTOM_DIR="../vendor/sifli/boards/sf32lb52/sf32lb52_devkit_lcd"
CONFIG_ARCH_BOARD_CUSTOM_DIR_RELPATH=y
CONFIG_ARCH_BOARD_CUSTOM_NAME="nsh"
CONFIG_ARCH_CHIP_ARM_CUSTOM=y
CONFIG_ARCH_CHIP_CUSTOM=y
CONFIG_ARCH_CHIP_CUSTOM_DIR="../vendor/sifli/chips/sf32lb52"
CONFIG_ARCH_CHIP_CUSTOM_DIR_RELPATH=y
CONFIG_ARCH_CHIP_CUSTOM_NAME="sf32lb52"
CONFIG_ARCH_CHIP_SF32LB52=y
CONFIG_ARMV8M_SYSTICK=y
CONFIG_ARCH_FPU=y
CONFIG_ARCH_DSP=y
CONFIG_ARM_MPU=y

# --- System ---
CONFIG_BOARD_EARLY_INITIALIZE=y
CONFIG_BOARD_LATE_INITIALIZE=y
CONFIG_BOARD_LOOPSPERMSEC=8499
CONFIG_NSH_LIBRARY=y
CONFIG_SYSTEM_NSH=y
CONFIG_INIT_ENTRYPOINT="velasense_main"
CONFIG_INIT_STACKSIZE=32768
CONFIG_DEFAULT_TASK_STACKSIZE=16096
CONFIG_IDLETHREAD_STACKSIZE=16096

# --- Memory ---
CONFIG_MM_REGIONS=2

# --- Console / UART ---
CONFIG_UART_SERIAL_CONSOLE=y
CONFIG_UART_BAUD=1000000
CONFIG_UART_BUFSZ=1024
CONFIG_BSP_USING_UART1=y
CONFIG_BSP_USING_UART2=y
CONFIG_BSP_UART1_RX_USING_DMA=y
CONFIG_BSP_UART2_RX_USING_DMA=y

# --- LCD / Display ---
CONFIG_SIFLI_LCD=y
CONFIG_LCD_USING_CO5300=y
CONFIG_LCD=y
CONFIG_LCD_DEV=y
CONFIG_LCD_MAXPOWER=100
CONFIG_BSP_USING_LCDC=y
CONFIG_DRIVERS_VIDEO=y
# CONFIG_EXAMPLES_LVGLDEMO is not set

# --- Touch ---
CONFIG_BSP_USING_TOUCHD=y
CONFIG_INPUT_FT6146=y
CONFIG_INPUT_TOUCHSCREEN=y
CONFIG_TOUCH_IRQ_PIN=31

# --- LVGL ---
CONFIG_GRAPHICS_LVGL=y
CONFIG_LV_USE_NUTTX=y
CONFIG_LV_USE_NUTTX_LCD=y
CONFIG_LV_USE_NUTTX_TOUCHSCREEN=y
CONFIG_LV_USE_LOG=y
CONFIG_LV_USE_CLIB_MALLOC=y
CONFIG_LV_USE_CLIB_SPRINTF=y
CONFIG_LV_USE_CLIB_STRING=y
# CONFIG_LV_USE_DEMO_WIDGETS is not set

# --- PWM ---
CONFIG_PWM=y
CONFIG_BSP_USING_PWM=y
CONFIG_BSP_USING_PWM2=y

# --- GPIO ---
CONFIG_DEV_GPIO=y

# --- I2C ---
CONFIG_I2C=y
CONFIG_I2C_DRIVER=y
CONFIG_BSP_USING_I2C=y
CONFIG_BSP_USING_I2C1=y
CONFIG_BSP_USING_I2C2=y

# --- Work Queue ---
CONFIG_SCHED_HPWORK=y
CONFIG_SCHED_LPWORK=y
CONFIG_SYSTEM_WORKQUEUE_NO_YIELD=y
CONFIG_SYSTEM_WORKQUEUE_STACK_SIZE=32768

# --- SPI ---
CONFIG_SPI=y
CONFIG_SPI_DRIVER=y
CONFIG_BSP_USING_SPI=y
CONFIG_BSP_USING_SPI1=y

# --- ADC ---
CONFIG_ADC=y
CONFIG_ANALOG=y
CONFIG_BSP_USING_ADC=y

# --- RTC ---
CONFIG_RTC=y
CONFIG_BSP_USING_RTC=y
CONFIG_RTC_ALARM=y
CONFIG_RTC_ARCH=y
CONFIG_RTC_DATETIME=y
CONFIG_RTC_DRIVER=y

# --- Watchdog ---
CONFIG_WATCHDOG=y
CONFIG_BSP_USING_WDT=y

# --- Timer ---
CONFIG_TIMER=y
CONFIG_BSP_USING_TIM=y
CONFIG_BSP_USING_BTIM1=y

# --- Buttons ---
CONFIG_INPUT=y
CONFIG_INPUT_BUTTONS=y
CONFIG_INPUT_BUTTONS_NBUTTONS=2

# --- Flash / MTD ---
CONFIG_MTD=y
CONFIG_MTD_BYTE_WRITE=y
CONFIG_BSP_USING_MPI2=y
CONFIG_FS_LITTLEFS=y
CONFIG_FS_LITTLEFS_PROGRAM_SIZE_FACTOR=1
CONFIG_FS_LOCK_BUCKET_SIZE=4
CONFIG_FS_ROMFS=y
CONFIG_ETC_ROMFS=y
CONFIG_FS_PROCFS=y
CONFIG_FS_TMPFS=y
CONFIG_FS_FAT=y

# --- Bluetooth (disabled for now, zblue has build issues) ---
# CONFIG_BT is not set
# CONFIG_DRIVERS_BLUETOOTH is not set
# CONFIG_DRIVERS_WIRELESS is not set

# --- USB ---
CONFIG_USBDEV=y
CONFIG_CDCACM=y
CONFIG_CDCACM_EPBULKIN=1
CONFIG_CDCACM_EPBULKOUT=2
CONFIG_CDCACM_EPINTIN=3
CONFIG_CDCACM_VENDORID=0x38F4
CONFIG_SF32LB52_USBDEV=y

# --- uORB Sensor Framework ---
CONFIG_UORB=y

# --- VelaSense Application ---

# --- NSH Built-in Apps ---
CONFIG_NSH_BUILTIN_APPS=y
CONFIG_BUILTIN=y

# --- Debug ---
CONFIG_DEBUG_FEATURES=y
CONFIG_DEBUG_ASSERTIONS=y
CONFIG_DEBUG_SCHED=y
CONFIG_DEBUG_SYMBOLS=y
CONFIG_SCHED_BACKTRACE=y
CONFIG_SYSTEM_DUMPSTACK=y

# Display-only application
CONFIG_VELASENSE_UI_DEMO=y
CONFIG_LCD_HOR_RES_MAX=390
CONFIG_LCD_VER_RES_MAX=450
CONFIG_TIMER_ARCH=y
# CONFIG_LCD_FRAMEBUFFER is not set
# CONFIG_VIDEO_FB is not set
# CONFIG_EXAMPLES_FB is not set
# CONFIG_LV_NUTTX_LCD_SINGLE_BUFFER is not set
# CONFIG_LV_NUTTX_LCD_DOUBLE_BUFFER is not set
CONFIG_LV_NUTTX_LCD_CUSTOM_BUFFER=y
CONFIG_LV_NUTTX_LCD_BUFFER_SIZE=40
CONFIG_LV_NUTTX_LCD_BUFFER_COUNT=0

# Boot diagnostics on the physical UART console
CONFIG_SYSLOG_CHAR=y
CONFIG_SYSLOG_DEVPATH="/dev/console"
CONFIG_SYSLOG_BUFFER=y
CONFIG_SYSLOG_INTBUFFER=y
CONFIG_INIT_ENTRYNAME="velasense"

# Demo refresh does not wait for the external tearing-effect signal.
# CONFIG_LCD_CO5300_VSYNC_ENABLE is not set
# HAL microsecond delays assume a 1ms SysTick period.
CONFIG_USEC_PER_TICK=1000
```

## firmware/apps/velasense/Kconfig
```kconfig
#
# VelaSense Application Kconfig
#

config VELASENSE
	bool "VelaSense emotion detection application"
	default n
	---help---
		Enable the VelaSense wrist-worn emotion arousal detection
		application. This includes sensor sampling, DSP, TinyML
		inference, LVGL UI, and BLE synchronization.

if VELASENSE

config VELASENSE_PPG_SENSOR
	bool "Enable PPG sensor (MAX86141)"
	default y
	---help---
		Enable the MAX86141 three-wavelength PPG sensor driver.

config VELASENSE_IMU_SENSOR
	bool "Enable IMU sensor (ICM-42688-P)"
	default y
	---help---
		Enable the ICM-42688-P six-axis IMU driver.

config VELASENSE_EDA_SENSOR
	bool "Enable EDA sensor (AD5940)"
	default y
	---help---
		Enable the AD5940 electrodermal activity sensor driver.
		If unavailable, the system degrades to PPG+IMU only.

config VELASENSE_TEMP_SENSOR
	bool "Enable skin temperature sensor (MAX30208)"
	default y
	---help---
		Enable the MAX30208 skin temperature sensor driver.

config VELASENSE_HAPTIC_DRIVER
	bool "Enable haptic motor driver (DRV2605L)"
	default y
	---help---
		Enable the DRV2605L haptic motor driver for event alerts.

config VELASENSE_FUEL_GAUGE
	bool "Enable fuel gauge (MAX17048)"
	default y
	---help---
		Enable the MAX17048 battery fuel gauge driver.

config VELASENSE_PPG_SAMPLE_RATE
	int "PPG sample rate (Hz)"
	default 100
	range 25 400

config VELASENSE_IMU_SAMPLE_RATE
	int "IMU sample rate (Hz)"
	default 100
	range 25 400

config VELASENSE_EDA_SAMPLE_RATE
	int "EDA sample rate (Hz)"
	default 32
	range 1 100

config VELASENSE_TEMP_SAMPLE_RATE
	int "Temperature sample rate (Hz)"
	default 1
	range 1 10

config VELASENSE_INFERENCE_WINDOW
	int "Inference window size (seconds)"
	default 60
	range 10 120

config VELASENSE_INFERENCE_INTERVAL
	int "Inference interval (seconds)"
	default 5
	range 1 30

config VELASENSE_SQI_THRESHOLD
	int "Signal quality threshold (x100)"
	default 70
	range 0 100
	---help---
		PPG Signal Quality Index threshold (0.0-1.0, stored as x100).
		Below this threshold, no emotion conclusion is output.

config VELASENSE_CONFIDENCE_THRESHOLD
	int "Confidence threshold (x100)"
	default 82
	range 0 100
	---help---
		Confidence threshold for event trigger (0.0-1.0, stored as x100).
		Must be exceeded for 15 continuous seconds.

config VELASENSE_EVENT_COOLDOWN
	int "Event cooldown (seconds)"
	default 300
	range 60 3600
	---help---
		Minimum time between same-type events.

config VELASENSE_MIMO_GATEWAY
	bool "Build Mimo Token Plan phone-side gateway library"
	default n
	---help---
		Build the Mimo API client, local fallback templates, and
		privacy policy enforcement module.  These components run
		on the phone-side gateway application, not on the wearable
		device itself.  Enable for unit testing or if building
		the phone app within the NuttX build tree.

endif # VELASENSE
```

## firmware/ble/Kconfig
```kconfig
# VelaSense BLE Service Configuration
#
# SPDX-License-Identifier: Apache-2.0
#
# Copyright (C) 2026 VelaSense Project

config VELASENSE_BLE
	bool "VelaSense BLE service"
	default n
	depends on BLUETOOTH
	---help---
	  Enable the VelaSense BLE GATT service for event synchronization,
	  device configuration, OTA firmware updates, and status reporting.

	  The BLE service provides a custom 128-bit UUID GATT service with
	  six characteristics for communication with the companion phone app.

if VELASENSE_BLE

# --- Connection Parameters ---

config BLE_CONN_INTERVAL_MIN
	int "Minimum connection interval (units of 1.25ms)"
	default 6
	range 6 3200
	---help---
	  Minimum BLE connection interval.  Lower values reduce latency
	  but increase power consumption.

	    6  = 7.5ms  (minimum, lowest latency)
	   12  = 15ms   (default, good balance)

config BLE_CONN_INTERVAL_MAX
	int "Maximum connection interval (units of 1.25ms)"
	default 12
	range 6 3200
	---help---
	  Maximum BLE connection interval.  The actual interval will be
	  negotiated between min and max.

	  Must be >= BLE_CONN_INTERVAL_MIN.

config BLE_CONN_SLAVE_LATENCY
	int "Slave latency (connection events to skip)"
	default 0
	range 0 499
	---help---
	  Number of connection events the peripheral may skip.
	  0 means always responsive (required for real-time event delivery).
	  Higher values save power but increase latency.

config BLE_CONN_SUP_TIMEOUT
	int "Supervision timeout (units of 10ms)"
	default 400
	range 10 3200
	---help---
	  Connection supervision timeout.  If no PDU is received within
	  this time, the connection is considered lost.
	    400 = 4 seconds (default)

# --- Advertising ---

config BLE_ADV_INTERVAL_MIN
	int "Minimum advertising interval (units of 0.625ms)"
	default 160
	range 32 16384
	---help---
	  Minimum advertising interval.
	    160 = 100ms (default, responsive discovery)

config BLE_ADV_INTERVAL_MAX
	int "Maximum advertising interval (units of 0.625ms)"
	default 320
	range 32 16384
	---help---
	  Maximum advertising interval.
	    320 = 200ms (default)

# --- Power Management ---

config BLE_TX_POWER_DEFAULT
	int "Default TX power (dBm)"
	default 0
	---help---
	  Default BLE transmit power in dBm.
	  Typical range: -20 to +10 dBm (platform dependent).

config BLE_TX_POWER_LOW
	int "Reduced TX power (dBm)"
	default -12
	---help---
	  Reduced TX power used when RSSI is very strong (device close
	  to phone).  Saves power when high signal strength is unnecessary.

config BLE_RSSI_POWER_THRESH
	int "RSSI threshold for power reduction (dBm)"
	default -40
	---help---
	  When measured RSSI exceeds this threshold, the device reduces
	  TX power to save energy.  Set to a high value (e.g., -20) to
	  be more aggressive about power savings.

# --- Reconnection ---

config BLE_RECONNECT_MIN_MS
	int "Minimum reconnect delay (ms)"
	default 1000
	range 100 10000
	---help---
	  Initial delay before the first reconnection attempt after
	  a disconnection.

config BLE_RECONNECT_MAX_MS
	int "Maximum reconnect delay (ms)"
	default 30000
	range 1000 120000
	---help---
	  Maximum reconnect delay (exponential backoff cap).

# --- Security ---

config BLE_PAIRING_ENABLED
	bool "Enable BLE pairing"
	default y
	---help---
	  Enable pairing and bonding with the companion phone.
	  When enabled, the device will request security level L2
	  (encrypted connection) on each new connection.

config BLE_JUST_WORKS
	bool "Use Just Works pairing"
	default y
	depends on BLE_PAIRING_ENABLED
	---help---
	  Use the "Just Works" pairing method (no passkey entry required).
	  This is less secure than passkey pairing but more convenient.
	  Disable this to require a 6-digit passkey on the phone.

# --- Sync Protocol ---

config BLE_SYNC_QUEUE_SIZE
	int "Sync event queue size (must be power of 2)"
	default 128
	---help---
	  Maximum number of events buffered during disconnection.
	  Must be a power of two.  Events beyond this limit are dropped
	  (oldest first).
	    128 = ~100 events + headroom
	    256 = ~200 events + headroom

config BLE_SYNC_BATCH_MAX
	int "Maximum events per sync batch"
	default 10
	range 1 50
	---help---
	  Maximum number of events sent in a single sync batch.
	  Higher values are more efficient but may cause ATT timeouts.

config BLE_SYNC_TIMEOUT_MS
	int "Sync ACK timeout (ms)"
	default 5000
	range 1000 30000
	---help---
	  Time to wait for the phone to acknowledge a sync batch
	  before retrying.

config BLE_SYNC_MAX_RETRIES
	int "Maximum sync retries"
	default 3
	range 1 10
	---help---
	  Maximum number of retries for a sync batch before declaring
	  the sync session as failed.

# --- Device Status ---

config BLE_STATUS_INTERVAL_MS
	int "Device status notification interval (ms)"
	default 10000
	range 0 60000
	---help---
	  Interval between automatic Device Status notifications.
	  Set to 0 to disable periodic notifications (status will still
	  be readable on demand).

# --- Task ---

config BLE_TASK_STACKSIZE
	int "BLE task stack size (bytes)"
	default 2048
	---help---
	  Stack size for the BLE manager task thread.

config BLE_TASK_PRIORITY
	int "BLE task priority"
	default 100
	---help---
	  Priority of the BLE manager task thread.
	  Should be lower than sensor sampling tasks but higher than
	  UI tasks for responsive event delivery.

endif # VELASENSE_BLE
```

## firmware/boards/velasense_board/Kconfig
```kconfig
#
# VelaSense Board Kconfig
#

if ARCH_BOARD_VELENSE_BOARD

config VELASENSE_BOARD
	bool
	default y

comment "VelaSense Board Options"

config VELASENSE_LCD_ENABLE
	bool "Enable LCD display"
	default y
	depends on SIFLI_LCD
	---help---
		Enable the CO5300 AMOLED display for the VelaSense wrist UI.

config VELASENSE_TOUCH_ENABLE
	bool "Enable touch input"
	default y
	depends on INPUT_FT6146
	---help---
		Enable the FT6146 capacitive touch controller.

config VELASENSE_BLE_ENABLE
	bool "Enable Bluetooth"
	default y
	depends on BT
	---help---
		Enable BLE for event synchronization with phone.

config VELASENSE_HAPTIC_ENABLE
	bool "Enable haptic vibration"
	default y
	---help---
		Enable the DRV2605L haptic driver for event alerts.

endif
```
